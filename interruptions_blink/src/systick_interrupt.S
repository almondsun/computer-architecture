.syntax unified
.cpu cortex-m4
.thumb

#include "stm32l476_regs.inc"

.extern SystemCoreClock
.extern SystemCoreClockUpdate

.global systick_init_1ms_interrupt
.global systick_wait_for_interrupt
.global systick_consume_elapsed_ms
.global SysTick_Handler

.type systick_init_1ms_interrupt, %function
.type systick_wait_for_interrupt, %function
.type systick_consume_elapsed_ms, %function
.type SysTick_Handler, %function

.section .text.systick_interrupt, "ax", %progbits
.align 2

/*
 * systick_init_1ms_interrupt
 * Purpose: Configure SysTick for a 1 ms period using interrupt mode.
 * Side effects: Updates SystemCoreClock, resets elapsed counter, and enables
 *               SysTick exception generation.
 */
systick_init_1ms_interrupt:
    push    {lr}

    /* Refresh SystemCoreClock so timing uses the active clock tree. */
    bl      SystemCoreClockUpdate

    ldr     r0, =SystemCoreClock
    ldr     r0, [r0]                    /* SystemCoreClock [Hz]. */
    ldr     r1, =1000
    udiv    r0, r0, r1                  /* SysTick ticks per millisecond. */
    cmp     r0, #0
    beq     systick_interrupt_config_error

    subs    r0, r0, #1
    ldr     r1, =SYSTICK_LOAD_MAX
    cmp     r0, r1
    bhi     systick_interrupt_config_error

    /* Reset elapsed milliseconds before enabling periodic interrupts. */
    ldr     r1, =systick_elapsed_ms
    movs    r2, #0
    str     r2, [r1]

    ldr     r1, =SYSTICK_BASE
    str     r0, [r1, #SYSTICK_LOAD_OFFSET]
    movs    r0, #0
    str     r0, [r1, #SYSTICK_VAL_OFFSET]
    movs    r0, #(SYSTICK_CTRL_CLKSOURCE | SYSTICK_CTRL_TICKINT | SYSTICK_CTRL_ENABLE)
    str     r0, [r1, #SYSTICK_CTRL_OFFSET]

    pop     {pc}

systick_interrupt_config_error:
    b       systick_interrupt_config_error

.size systick_init_1ms_interrupt, . - systick_init_1ms_interrupt

/*
 * systick_wait_for_interrupt
 * Purpose: Suspend CPU execution until the next interrupt event.
 */
systick_wait_for_interrupt:
    wfi
    bx      lr

.size systick_wait_for_interrupt, . - systick_wait_for_interrupt

/*
 * systick_consume_elapsed_ms
 * Purpose: Atomically read and clear the accumulated SysTick elapsed time [ms].
 * Output : r0 = elapsed milliseconds since previous consume call.
 */
systick_consume_elapsed_ms:
    mrs     r2, PRIMASK
    cpsid   i
    ldr     r1, =systick_elapsed_ms
    ldr     r0, [r1]
    movs    r3, #0
    str     r3, [r1]
    msr     PRIMASK, r2
    bx      lr

.size systick_consume_elapsed_ms, . - systick_consume_elapsed_ms

/*
 * SysTick_Handler
 * Purpose: ISR that accumulates elapsed milliseconds for the main loop.
 */
SysTick_Handler:
    ldr     r0, =systick_elapsed_ms
    ldr     r1, [r0]
    adds    r1, r1, #1
    str     r1, [r0]
    bx      lr

.size SysTick_Handler, . - SysTick_Handler

.section .bss.systick_interrupt, "aw", %nobits
.align 2

/* Accumulated elapsed time generated by SysTick ISR [ms]. */
systick_elapsed_ms:
    .space 4
